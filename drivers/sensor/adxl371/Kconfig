## drivers/sensor/adxl371/Kconfig
```kconfig
# Micropower, 3-Axis, +/-200g Digital Accelerometer

# Copyright (c) 2018 Analog Devices Inc.
# SPDX-License-Identifier: Apache-2.0

menuconfig ADXL371
	bool "ADXL371 Three Axis High-g I2C/SPI accelerometer"
	default y
	depends on DT_HAS_ADI_ADXL371_ENABLED
	select I2C if $(dt_compat_on_bus,$(DT_COMPAT_ADI_ADXL371),i2c)
	select SPI if $(dt_compat_on_bus,$(DT_COMPAT_ADI_ADXL371),spi)
	help
	  Enable driver for ADXL371 Three-Axis Digital Accelerometers.

if ADXL371

choice ADXL371_OP_MODE
	prompt "Operating mode"
	default ADXL371_PEAK_DETECT_MODE

config ADXL371_PEAK_DETECT_MODE
	bool "Max Peak detect mode"
	help
	  In most high-g applications, a single (3-axis) acceleration sample at
	  the peak of an impact event contains sufficient information
	  about the event, and the full acceleration history is not required.
	  In this mode the device returns only the over threshold
	  Peak Acceleration between two consecutive sample fetches.

config ADXL371_MEASUREMENT_MODE
	bool "Measurement Mode"
	help
	  In this mode, acceleration data is provided continuously at the
	  output data rate (ODR).

endchoice

config ADXL371_ACTIVITY_THRESHOLD
	int "Activity threshold in mg"
	range 0 200000
	default 500
	help
	  Threshold for activity detection.

config ADXL371_INACTIVITY_THRESHOLD
	int "In-activity threshold in mg"
	range 0 200000
	default 400
	help
	  Threshold for in-activity detection.

config ADXL371_ACTIVITY_TIME
	int "Activity time"
	range 0 255
	default 1
	help
	  The activity timer implements a robust activity detection that
	  minimizes false positive motion triggers. When the timer is used,
	  only sustained motion can trigger activity detection.
	  Number of multiples of 3.3 ms activity timer for which above threshold
	  acceleration is required to detect activity. It is 3.3 ms per code
	  for 6400 Hz ODR, and it is 6.6 ms per code for 3200 Hz ODR and below.

config ADXL371_INACTIVITY_TIME
	int "In-activity time"
	range 0 255
	default 2
	help
	  The time that all enabled axes must be lower than the inactivity
	  threshold for an inactivity event to be detected. Number of multiples
	  of 26 ms inactivity timer for which below threshold acceleration is
	  required to detect inactivity. It is 26 ms per code for 3200 Hz ODR
	  and below, and it is 13 ms per code for 6400 Hz ODR.

config ADXL371_REFERENCED_ACTIVITY_DETECTION_MODE
	bool "Use referenced activity/in-activity detection"
	default y
	help
	  Activity detection can be configured as referenced or absolute.
	  When using absolute activity detection, acceleration samples are
	  compared directly to a user set threshold to determine whether
	  motion is present. In many applications, it is advantageous for
	  activity detection to be based not on an absolute threshold,
	  but on a deviation from a reference point or orientation.

choice ADXL371_TRIGGER_MODE
	prompt "Trigger mode"
	default ADXL371_TRIGGER_NONE
	help
	  Specify the type of triggering used by the driver.

config ADXL371_TRIGGER_NONE
	bool "No trigger"

config ADXL371_TRIGGER_GLOBAL_THREAD
	bool "Use global thread"
	depends on GPIO
	select ADXL371_TRIGGER

config ADXL371_TRIGGER_OWN_THREAD
	bool "Use own thread"
	depends on GPIO
	select ADXL371_TRIGGER

endchoice

config ADXL371_TRIGGER
	bool

config ADXL371_THREAD_PRIORITY
	int "Thread priority"
	depends on ADXL371_TRIGGER_OWN_THREAD && ADXL371_TRIGGER
	default 10
	help
	  Priority of thread used by the driver to handle interrupts.

config ADXL371_THREAD_STACK_SIZE
	int "Thread stack size"
	depends on ADXL371_TRIGGER_OWN_THREAD && ADXL371_TRIGGER
	default 1024
	help
	  Stack size of thread used by the driver to handle interrupts.

endif # ADXL371
```

## dts/bindings/sensor/adi,adxl371-common.yaml
```yaml
# Copyright (c) 2022 Analog Devices Inc.
# SPDX-License-Identifier: Apache-2.0

include: sensor-device.yaml

properties:
  odr:
    type: int
    default: 0
    description: |
          Accelerometer sampling frequency (ODR). Default is power on reset value.
            0 # 320Hz
            1 # 640Hz
            2 # 1280Hz
            3 # 2560Hz
            4 # 5120Hz
    enum:
      - 0
      - 1
      - 2
      - 3
      - 4

  bw:
    type: int
    default: 12
    description: |
          Low-Pass (Antialiasing) Filter corner frequency. Default is power on reset value.
            0 # 160Hz
            1 # 320Hz
            2 # 640Hz
            3 # 1280Hz
            4 # 2560Hz
            12 # Disabled
    enum:
      - 0
      - 1
      - 2
      - 3
      - 4
      - 12

  hpf:
    type: int
    default: 4
    description: |
          High-Pass Filter corner frequency. Default is power on reset value.
            0 # ODR/210
            1 # ODR/411
            2 # ODR/812
            3 # ODR/1616
            4 # Disabled
    enum:
      - 0
      - 1
      - 2
      - 3
      - 4
```

## dts/bindings/sensor/adi,adxl371-i2c.yaml
```yaml
# Copyright (c) 2018 Analog Devices Inc.
# SPDX-License-Identifier: Apache-2.0

description: ADXL371 3-axis high-g I2C/SPI accelerometer

compatible: "adi,adxl371"

include: ["i2c-device.yaml", "adi,adxl371-common.yaml"]

properties:
  int1-gpios:
    type: phandle-array
    description: |
      The INT1 signal defaults to active high as produced by the
      sensor.  The property value should ensure the flags properly
      describe the signal that is presented to the driver.
```
